## drivers/input/fingerprint/goodix/Kconfig
```kconfig
config FINGERPRINT_GOODIX_GF3208
	tristate "Goodix GF3208 fingerprint driver support"
	depends on FINGERPRINT
	help
	  Say Y here to enable goodix fingerprint driver support!

config AP_CONTROL_CLK
	bool "Enable AP_CONTROL_CLK"
	depends on FINGERPRINT
```

## drivers/media/platform/msm/vidc-nougat/Kconfig
```kconfig
#
# VIDEO CORE
#

menuconfig MSM_VIDC_V4L2_NOUGAT
	bool "Qualcomm MSM V4L2 based video driver for Nougat"
		depends on ARCH_MSM && VIDEO_V4L2
		select VIDEOBUF2_CORE

source "drivers/media/platform/msm/vidc-nougat/vmem/Kconfig"
source "drivers/media/platform/msm/vidc-nougat/governors/Kconfig"
```

## drivers/media/platform/msm/vidc-nougat/vmem/Kconfig
```kconfig
menuconfig MSM_VIDC_VMEM_NOUGAT
	bool "Qualcomm Technologies Inc MSM VMEM driver"
	depends on ARCH_MSM && MSM_VIDC_V4L2_NOUGAT
```

## drivers/staging/Kconfig.rej
```kconfig
--- drivers/staging/Kconfig
+++ drivers/staging/Kconfig
@@ -108,4 +108,6 @@ source "drivers/staging/skein/Kconfig"
 
 source "drivers/staging/unisys/Kconfig"
 
+source "drivers/staging/prima/Kconfig"
+
 endif # STAGING
```
